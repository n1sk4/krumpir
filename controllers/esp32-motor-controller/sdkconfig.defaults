## controllers/esp32-motor-controller/sdkconfig.defaults
```kconfig
CONFIG_FREERTOS_HZ=1000
CONFIG_ESP_CONSOLE_UART_BAUDRATE=115200
CONFIG_ESP_TASK_WDT_EN=y
CONFIG_GPTIMER_ISR_IRAM_SAFE=y
CONFIG_FREERTOS_UNICORE=n
```
