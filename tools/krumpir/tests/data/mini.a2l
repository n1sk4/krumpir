ASAP2_VERSION 1 71
/begin PROJECT mini ""
/begin MODULE mini ""
/* A small A2L in the form xcpclient writes for XCPlite, for the EcuPort tests */
/begin MOD_COMMON "" BYTE_ORDER MSB_LAST /begin RECORD_LAYOUT U8 FNC_VALUES 1 UBYTE ROW_DIR DIRECT /end RECORD_LAYOUT /begin RECORD_LAYOUT F32 FNC_VALUES 1 FLOAT32_IEEE ROW_DIR DIRECT /end RECORD_LAYOUT /begin RECORD_LAYOUT F64 FNC_VALUES 1 FLOAT64_IEEE ROW_DIR DIRECT /end RECORD_LAYOUT /end MOD_COMMON
/begin MOD_PAR "" EPK "mini_build_1" ADDR_EPK 0xFFFFFF00 /begin MEMORY_SEGMENT cal "" DATA FLASH INTERN 0x1000 16 -1 -1 -1 -1 -1 /end MEMORY_SEGMENT /end MOD_PAR
/begin IF_DATA XCP
 /begin XCP_ON_UDP_IP 0x0104 5555 ADDRESS "127.0.0.1" /end XCP_ON_UDP_IP
/end IF_DATA
/begin TYPEDEF_CHARACTERISTIC setpoint "" VALUE F32 0 NO_COMPU_METHOD 100 450 /end TYPEDEF_CHARACTERISTIC
/begin TYPEDEF_CHARACTERISTIC mode "" VALUE U8 0 NO_COMPU_METHOD 0 3 /end TYPEDEF_CHARACTERISTIC
/begin TYPEDEF_STRUCTURE cal_page "" 8 /begin STRUCTURE_COMPONENT setpoint setpoint 0 /end STRUCTURE_COMPONENT /begin STRUCTURE_COMPONENT mode mode 4 /end STRUCTURE_COMPONENT /end TYPEDEF_STRUCTURE
/begin TYPEDEF_MEASUREMENT temp "" FLOAT32_IEEE NO_COMPU_METHOD 0 0 -1e12 1e12 /end TYPEDEF_MEASUREMENT
/begin TYPEDEF_MEASUREMENT gains "" FLOAT64_IEEE NO_COMPU_METHOD 0 0 -1e12 1e12 MATRIX_DIM 3 /end TYPEDEF_MEASUREMENT
/begin TYPEDEF_STRUCTURE inner_t "" 24 /begin STRUCTURE_COMPONENT gains gains 0 /end STRUCTURE_COMPONENT /end TYPEDEF_STRUCTURE
/begin TYPEDEF_STRUCTURE loop_t "" 32 /begin STRUCTURE_COMPONENT temp temp 0 /end STRUCTURE_COMPONENT /begin STRUCTURE_COMPONENT inner inner_t 8 /end STRUCTURE_COMPONENT /end TYPEDEF_STRUCTURE
/begin INSTANCE s_loop "" loop_t 0x2000 ECU_ADDRESS_EXTENSION 0
 /begin IF_DATA XCP
  /begin DAQ_EVENT VARIABLE /begin DEFAULT_EVENT_LIST EVENT 1 /end DEFAULT_EVENT_LIST /end DAQ_EVENT
 /end IF_DATA
/end INSTANCE
/begin INSTANCE task.local "" loop_t 0x40FF00 ECU_ADDRESS_EXTENSION 2
 /begin IF_DATA XCP
  /begin DAQ_EVENT VARIABLE /end DAQ_EVENT
 /end IF_DATA
/end INSTANCE
/begin MEASUREMENT s_count "" ULONG NO_COMPU_METHOD 0 0 0 4294967295 ECU_ADDRESS 0x2100
 /begin IF_DATA XCP
  /begin DAQ_EVENT VARIABLE /end DAQ_EVENT
 /end IF_DATA
/end MEASUREMENT
/begin MEASUREMENT s_buf "" UBYTE NO_COMPU_METHOD 0 0 0 255 ECU_ADDRESS 0x3000 MATRIX_DIM 600 /end MEASUREMENT
/begin INSTANCE cal_page "" cal_page 0x1000 /end INSTANCE
/end MODULE
/end PROJECT
